## Kconfig
```kconfig
# SPDX-License-Identifier: MIT
config ZMK_DEFAULT_LAYER
    bool "Per-endpoint WIN/MAC base layer"
config ZMK_DEFAULT_LAYER_MIN_INDEX
    int "First saved base layer index"
    default 0
config ZMK_DEFAULT_LAYER_MAX_INDEX
    int "Last saved base layer index"
    default 1
```

## config/west.yml
```yaml
manifest:
  remotes:
    - name: zmkfirmware
      url-base: https://github.com/zmkfirmware

    - name: keebJP
      url-base: https://github.com/keebJP

    - name: ssbb
      url-base: https://github.com/ssbb

    - name: Hqzuki
      url-base: https://github.com/Hqzuki

    - name: cormoran
      url-base: https://github.com/cormoran

    - name: caksoylar
      url-base: https://github.com/caksoylar

    - name: mjmjm0101
      url-base: https://github.com/mjmjm0101

  projects:
    - name: zmk
      remote: zmkfirmware
      revision: acfd8e5ea76cf23ad1c9b6b99848f97a95224257
      import: app/west.yml

    - name: zmk-pmw3610-driver
      remote: keebJP
      revision: 5e04553ab803d24405bd45621a41310ea3050e59

    - name: zmk-mouse-gesture
      remote: Hqzuki
      revision: 97332d356ac07df09b68df3f4d60029388d908f5

    - name: zmk-listeners
      remote: ssbb
      revision: c240ceaf353d3138bea7695eef17049b7ade995b

    - name: zmk-rgbled-widget
      remote: caksoylar
      revision: 8756cb7b8114069fa3c25c6f6c990f24988fceff

    - name: zmk-input-processor-scroll-inertia
      remote: mjmjm0101
      revision: f7dadefee453d555fe066d13a3de3bb60739b45e

  self:
    path: config
```
